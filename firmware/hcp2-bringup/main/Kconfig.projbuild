## firmware/hcp2-bringup/main/Kconfig.projbuild
```kconfig
menu "HCP2 bring-up"

choice HCP2_BRINGUP_RESPONDER_MODE
    prompt "Responder mode"
    default HCP2_BRINGUP_LP_IN_LOOP

config HCP2_BRINGUP_LP_IN_LOOP
    bool "LP core in the loop"
    help
        Load the real HCP2 LP blob and let the LP core answer the simulated bus.

config HCP2_BRINGUP_HP_FALLBACK
    bool "HP fallback responder"
    help
        Run hcp2_core on the HP core. This is a Wokwi/bring-up fallback only.

endchoice

config HCP2_BRINGUP_RESTART_INTERVAL_MS
    int "esp_restart test interval in milliseconds"
    default 0
    help
        Set to 0 to disable restart-loop mode. Non-zero values create a
        low-priority test task that calls esp_restart() after the interval.

config HCP2_BRINGUP_PANIC_INTERVAL_MS
    int "panic reset test interval in milliseconds"
    default 0
    help
        Set to 0 to disable panic-reset mode. Non-zero values create a
        low-priority test task that aborts after the interval so the panic
        handler resets the HP core.

config HCP2_BRINGUP_TASK_WDT_INTERVAL_MS
    int "task watchdog reset test interval in milliseconds"
    default 0
    help
        Set to 0 to disable task-WDT reset mode. Non-zero values create a
        test task that subscribes itself to the task watchdog after the
        interval and then stops feeding it.

config HCP2_BRINGUP_TASK_WDT_TRIGGER_PANIC
    bool "Trigger panic on task watchdog timeout"
    default y
    depends on HCP2_BRINGUP_TASK_WDT_INTERVAL_MS > 0
    help
        Keep enabled for reset-chaos characterization. Disable for the
        continuity-safe watchdog mode: the HP core logs the timeout instead of
        resetting, so the LP core keeps owning the HCP2 bus pins.

config HCP2_BRINGUP_RTC_WDT_INTERVAL_MS
    int "RTC watchdog reset test interval in milliseconds"
    default 0
    help
        Set to 0 to disable RTC-WDT reset mode. Non-zero values create a
        low-priority test task that arms the RTC watchdog after the interval.

config HCP2_BRINGUP_SCRIPTED_COMMANDS
    bool "Run scripted HP-to-LP command cycle"
    default n
    depends on HCP2_BRINGUP_LP_IN_LOOP
    help
        HIL diagnostic only. Periodically sends open, close, and light commands
        through the real HP supervisor mailbox so the LP responder must encode
        virtual button presses in status replies.

config HCP2_BRINGUP_SCRIPTED_COMMAND_INTERVAL_MS
    int "Scripted command interval in milliseconds"
    default 1200
    depends on HCP2_BRINGUP_SCRIPTED_COMMANDS

config HCP2_BRINGUP_MAILBOX_TEST_DOUBLE
    bool "Run LP mailbox supervisor test double at boot"
    default y if HCP2_BRINGUP_HP_FALLBACK
    default n
    help
        Exercises skip-reload, heartbeat, and command epoch paths against a
        synthetic healthy LP mailbox during Wokwi/HP integration tests. The
        LP-in-the-loop mode uses the real mailbox ABI instead.

config HCP2_BRINGUP_WOKWI_UART_NO_PARITY
    bool "Use no UART parity for Wokwi custom-chip UART"
    default n
    help
        Wokwi's custom-chip UART API exposes baud rate but not parity. Enable
        only in the Wokwi overlay so the custom master and the ESP UART model
        agree on 8N1 framing. Real hardware must keep HCP2's 57600 8E1 framing.

config HCP2_BRINGUP_WOKWI_LP_TX_PROBE
    bool "Send a one-shot LP-UART frame for Wokwi diagnostics"
    default n
    depends on HCP2_BRINGUP_LP_IN_LOOP
    help
        Diagnostic only. Sends one valid HCP2 scan response directly from the
        LP core after boot so Wokwi LP-UART TX pin routing can be tested without
        waiting for a received master frame.

config HCP2_BRINGUP_LP_UART_STATUS_LOG
    bool "Log raw LP-UART registers"
    default n
    depends on HCP2_BRINGUP_LP_IN_LOOP
    help
        Diagnostic only. Periodically logs raw LP-UART registers from the HP
        supervisor task. This is useful for simulator-fidelity probes but too
        noisy for normal Wokwi and HIL runs.

config HCP2_BRINGUP_FORCE_LP_RELOAD
    bool "Force LP blob reload at boot"
    default n
    depends on HCP2_BRINGUP_LP_IN_LOOP
    help
        Diagnostic only. Stops and reloads the LP core even if the mailbox
        heartbeat is healthy. This is useful for HIL probe images that need a
        freshly loaded LP binary after an HP-only reset.

config HCP2_BRINGUP_LP_WDT_ENABLE
    bool "Enable diagnostic LP watchdog feed path"
    default n
    depends on HCP2_BRINGUP_LP_IN_LOOP
    help
        Diagnostic only. The ESP32-C6 LP-WDT block exposes CPU/system reset
        actions but the reset scope must be proven on real silicon before this
        can become a production safety mechanism. When disabled, production
        recovery is HP-supervisor stale-heartbeat reload only. The first HIL
        probe showed that the targetless RESET_CPU setup does not reset the LP
        core after feeding stops; keep this off unless testing a new,
        explicitly documented LP-only reset path.

config HCP2_BRINGUP_LP_WDT_TIMEOUT_TICKS
    int "Diagnostic LP watchdog timeout in LP-WDT ticks"
    default 200000
    depends on HCP2_BRINGUP_LP_WDT_ENABLE

config HCP2_BRINGUP_LP_WDT_STALL_AFTER_MS
    int "Diagnostic LP watchdog stall-after interval in milliseconds"
    default 0
    depends on HCP2_BRINGUP_LP_WDT_ENABLE
    help
        Set to 0 for normal feeding. Non-zero values make the LP core stop
        feeding the LP-WDT after the interval so HIL can identify whether the
        watchdog resets only the LP core or also disrupts HP/bus ownership.

endmenu
```

## firmware/hcp2-bringup/sdkconfig.defaults
```kconfig
CONFIG_IDF_TARGET="esp32c6"
CONFIG_IDF_TARGET_ESP32C6=y
CONFIG_FREERTOS_HZ=1000
CONFIG_UART_ISR_IN_IRAM=y
CONFIG_ESP_CONSOLE_UART_DEFAULT=y
CONFIG_ESP_CONSOLE_UART_NUM=0
CONFIG_ESP_CONSOLE_UART_BAUDRATE=115200
CONFIG_HCP2_BRINGUP_LP_IN_LOOP=y
CONFIG_HCP2_BRINGUP_RESTART_INTERVAL_MS=0
CONFIG_ULP_COPROC_ENABLED=y
CONFIG_ULP_COPROC_TYPE_LP_CORE=y
CONFIG_ULP_COPROC_RESERVE_MEM=16320
CONFIG_ULP_HP_UART_CONSOLE_PRINT=n
```

## firmware/hcp2-c6-dma-probe/sdkconfig.defaults
```kconfig
CONFIG_IDF_TARGET="esp32c6"
CONFIG_IDF_TARGET_ESP32C6=y

CONFIG_FREERTOS_HZ=1000
CONFIG_ESP_MAIN_TASK_STACK_SIZE=8192

CONFIG_ESP_CONSOLE_USB_SERIAL_JTAG=y

CONFIG_UART_ISR_IN_IRAM=y
CONFIG_UHCI_ISR_HANDLER_IN_IRAM=y
CONFIG_UHCI_ISR_CACHE_SAFE=y
CONFIG_GDMA_CTRL_FUNC_IN_IRAM=y
CONFIG_GDMA_ISR_HANDLER_IN_IRAM=y
CONFIG_GPTIMER_ISR_HANDLER_IN_IRAM=y

CONFIG_ULP_COPROC_ENABLED=y
CONFIG_ULP_COPROC_TYPE_LP_CORE=y
CONFIG_ULP_COPROC_RESERVE_MEM=16320
CONFIG_ULP_HP_UART_CONSOLE_PRINT=n

CONFIG_ESP_SYSTEM_PANIC_PRINT_HALT=y
# CONFIG_ESP_SYSTEM_PANIC_PRINT_REBOOT is not set

CONFIG_ESP_TASK_WDT_INIT=y
CONFIG_ESP_TASK_WDT_PANIC=y
```

## firmware/hcp2-lp/sdkconfig.defaults
```kconfig
CONFIG_IDF_TARGET="esp32c6"
CONFIG_IDF_TARGET_ESP32C6=y
CONFIG_FREERTOS_HZ=1000
CONFIG_ESPTOOLPY_FLASHSIZE_4MB=y
CONFIG_ULP_COPROC_ENABLED=y
CONFIG_ULP_COPROC_TYPE_LP_CORE=y
CONFIG_ULP_COPROC_RESERVE_MEM=16320
CONFIG_ULP_HP_UART_CONSOLE_PRINT=n
```
